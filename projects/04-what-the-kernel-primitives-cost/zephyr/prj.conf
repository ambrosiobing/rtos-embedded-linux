## CMakeLists.txt
```
# projects/04-what-the-kernel-primitives-cost/zephyr/CMakeLists.txt
#
# The measurement core is pulled in from ../adapter, not copied. It carries no kernel header, so
# the same object that runs here is the one host/emit_capture.c builds against, and the capture
# format cannot drift between the firmware and the reduction that parses it.
#
#   cmake -B build-p04-zephyr -GNinja -DBOARD=nucleo_h7a3zi_q \
#         -S projects/04-what-the-kernel-primitives-cost/zephyr
#
# A native_sim build is useful for compiling and useless for measuring, and the port says so by
# reporting a clock of zero, which makes the reduction refuse every capture it produces.
cmake_minimum_required(VERSION 3.20.0)

# THE OVERLAY IS NAMED HERE, NOT LEFT TO DETECTION. Zephyr finds an app.overlay in the
# application directory on a fresh configure. On Friday 9 October 2026 the file was added to a
# build directory configured days earlier, ninja re-ran CMake, and the overlay was not found:
# no "Found devicetree overlay" line, and the zephyr,user node the marker reads did not exist.
# A build that silently differs from the tree by which files happened to exist at first
# configure is the stale-flash problem one level up, so the overlay is stated. This variable is
# read by find_package(Zephyr) and must be set before it.
set(DTC_OVERLAY_FILE ${CMAKE_CURRENT_SOURCE_DIR}/app.overlay)

find_package(Zephyr REQUIRED HINTS $ENV{ZEPHYR_BASE})
project(p04_primitives_zephyr C)

target_sources(app PRIVATE src/main.c src/mutex_case.c ../adapter/measure.c ../adapter/campaign.c)
```

## prj.conf
```kconfig
# projects/04-what-the-kernel-primitives-cost/zephyr/prj.conf

# k_poll is the whole point of the several-objects row, and it is not on by default.
CONFIG_POLL=y

# The marker pin for criterion 5, PB4 at CN7 pin 19, named in app.overlay and nowhere else. One
# toggle per period boundary, so the MCC 118 sees one edge per period in either direction. Added
# Friday 9 October 2026, the day the lead was found to be fitted with nothing driving it.
CONFIG_GPIO=y

# The measurement prints integers only. Floating point formatting would pull a soft-float
# formatter into an application whose subject is how long things take.
CONFIG_CBPRINTF_FP_SUPPORT=n

CONFIG_MAIN_STACK_SIZE=4096

# OFF, DELIBERATELY. Assertions are useful and they are also code that runs inside the brackets
# this application exists to measure. A table whose numbers include an assertion's cost is a
# table about this build rather than about the kernel.
CONFIG_ASSERT=n

# OFF, AND IT WAS ON BY ACCIDENT UNTIL FRIDAY 9 OCTOBER 2026.
#
# CONFIG_TIMESLICING defaults to y and CONFIG_TIMESLICE_SIZE defaults to 20 ms, so every figure
# this project published before today was taken with a 20 ms timeslice compiled in and enabled.
# That was not a decision. It was a default nobody read, in a project whose entire subject is
# what kernel primitives cost.
#
# It matters for two separate reasons and only the second changes a number.
#
# The scheduler carries slice bookkeeping in the path every bracket here contains, and Zephyr's
# own latency_measure suite sets CONFIG_TIMESLICING=n. Comparing against it with this on would
# compare two kernels configured differently, which is the error criterion 2 exists to avoid.
#
# And the yield case runs its partner at the measurer's own priority, which is exactly the
# arrangement timeslicing acts on. Sixty-four brackets of about 9 us is under 600 us in total,
# far short of a 20 ms slice, so no slice boundary fell inside any run and the published minima
# stand as measured. The code was in the path; the behaviour never fired.
CONFIG_TIMESLICING=n

# THE INSTRUMENT UPSTREAM USES, added Friday 9 October 2026 so that ours can be the same one.
#
# Criterion 2 failed by a factor of five to seven on two spans whose endpoints match the upstream
# suite's line for line, and the residuals agree with each other to 5.6 per cent across two
# different paths, which points outside the operation rather than inside it. k_cycle_get_32() is
# the only thing this project has ever held the stopwatch with, and it has never been compared
# against anything.
#
# This is also what Zephyr's own latency_measure sets, so with it the two sides differ in one
# fewer thing.
CONFIG_TIMING_FUNCTIONS=y

# OFF, TO MATCH UPSTREAM, AND THIS ONE IS NOT A TIDYING-UP. READ THE CAVEAT.
#
# The board's own defconfig sets CONFIG_ARM_MPU=y and CONFIG_HW_STACK_PROTECTION=y, explicitly,
# under the comment "Enable HW stack protection". Zephyr's latency_measure sets it back to n in
# its prj.conf, with a comment and an issue number. So both sides state what they want and they
# want opposite things, which is why this was never going to be found by reasoning about defaults.
#
# With an MPU and stack protection the kernel reprograms a guard region on every thread switch.
# That is a per-switch cost sitting in the path of every row in this table, and it has the shape
# of the residual criterion 2 is left with: proportional rather than constant, and present in
# both compared rows whose only common content is a context switch.
#
# THE CAVEAT, BECAUSE THE CHAPTER MUST NOT READ AS ADVICE. Turning a stack guard off is a real
# reduction in safety and it is done here to make one comparison like for like, not because it is
# a good idea in firmware anybody ships. Real firmware on this board will have it on, because the
# board's defconfig turns it on deliberately. **The figure a chapter should quote for ordinary use
# is the one with protection ON**, which is the run of Friday 9 October 2026 at 09:40, already
# recorded in BENCH.md.
#
# Which means this is not only a comparison fix. The difference between the two runs is **what
# hardware stack protection costs per context switch on this part**, and that is a question an
# engineer choosing between them actually has, answered for the first time in this volume.
#
# AND THEN IT WENT BACK ON, THE SAME EVENING, AND THIS IS WHY THE LINE BELOW IS A COMMENT.
#
# The comparison ran at 21:15 on Friday 9 October 2026, criterion 2 was met at 0.98 and 1.12, and
# the guard measured 178 counts per switch, 0.64 microseconds. That is the whole of what turning
# it off was for. Leaving it off afterwards would have done two things wrong at once: published
# a repository whose default build has a stack guard silently disabled, and made RESULTS.md
# quote figures that a reader building the tree could not reproduce, because the table carries
# the guard-on figures on purpose.
#
# A temporary change needs its removal written at the moment it is made. This project learned
# that on Tuesday 6 October 2026 from a jumper left in a wiring sheet that shorted a supply to a
# data line three runs later. The setting below is that jumper. To reproduce the criterion 2
# comparison, uncomment it, rebuild, and expect the 21:15 figures; the board's own defconfig
# supplies the y that applies otherwise.
#
# CONFIG_HW_STACK_PROTECTION=n
```

## app.overlay
```dts
/* projects/04-what-the-kernel-primitives-cost/zephyr/app.overlay: the one pin the witness watches.
 *
 * THE PIN IS NAMED HERE AND NOWHERE ELSE. The C reads it through GPIO_DT_SPEC_GET, the run
 * prints the controller and pin it was given, and docs/WIRING.md quotes this file. A pin named
 * in a comment is a pin that drifts from the code; a pin named in devicetree is the code.
 *
 * PB4, which is CN7 pin 19 on the Zio header, the pin ST labels D25. From UM2408 Rev 6, the
 * manual for the MB1363 board family, Table 18 on page 44, which is this board's own table and
 * not Table 17 for the H745 and H755 beside it: the two carry the identical row for PB4, so
 * the wrong table would have given the right answer with the wrong reasoning. Read for the
 * sibling firmware volume on Tuesday 6 October 2026 and reused here on Friday 9 October 2026,
 * because the lead to the MCC 118 is already on that pin and a pin chosen to suit the firmware
 * rather than the bench would have cost a rewiring for nothing.
 *
 * Why not an Arduino alias: Zephyr's arduino_r3_connector.dtsi for this board maps D0 to D15
 * and A0 to A5, and PB4 is on none of them. The Zio header's D16 to D72 have no Zephyr
 * binding, so the GPIO port and pin are named directly.
 *
 * Why zephyr,user: it is the node Zephyr provides for exactly this, an application-owned
 * property with no driver and no binding to write. The alternative, a gpio-leds node, would
 * have described the pin as a light.
 */
#include <zephyr/dt-bindings/gpio/gpio.h>

/ {
	zephyr,user {
		marker-gpios = <&gpiob 4 GPIO_ACTIVE_HIGH>;
	};
};
```

## src/mutex_case.c
```c
/* projects/04-what-the-kernel-primitives-cost/zephyr/src/mutex_case.c: criterion 4.
 *
 * THE ONLY ROW IN THE TABLE WHOSE ANSWER DEPENDS ON A PROTOCOL RATHER THAN ON A COUNT, and the
 * only one with a prediction attached before the run.
 *
 * Three threads, and the arrangement is the whole measurement:
 *
 *   measurer  priority 5, highest. Wants the lock
 *   medium    priority 6. Runnable, holds nothing, and is the entire point
 *   holder    priority 7, lowest. Holds the lock and is doing a bounded amount of work
 *
 * With priority inheritance the holder is lifted to the measurer's priority while the measurer
 * waits, so it runs ahead of medium, finishes and releases. The measurer waits for the holder's
 * remaining work and nothing else.
 *
 * Without it the holder stays at priority 7, medium at priority 6 runs first and to completion,
 * and only then does the holder get to finish and release. **The measurer waits for a thread
 * that has nothing to do with the lock it wants.** That is priority inversion, and the number
 * is how much it costs.
 *
 * THE PREDICTION, WRITTEN BEFORE THE FIRST RUN. Inheritance on should cost about the holder's
 * remaining work. Inheritance off should cost about that plus the whole of medium's work.
 * Medium is given four times the holder's work, so the two figures should differ by a factor of
 * roughly four or five. **Criterion 4 is refuted if they come out the same**, and the honest
 * reading of that would be that this case is not actually contended rather than that
 * inheritance does nothing.
 *
 * WHAT IS BEING COMPARED, SAID PLAINLY BECAUSE IT IS EASY TO MISREAD. Zephyr's `k_mutex` always
 * inherits priority and offers no switch, so the second arm is not the same object configured
 * differently: it is a binary semaphore used as a lock, which is the ordinary way to hold mutual
 * exclusion without a protocol. **The comparison is between two protocols, not between two
 * settings of one object**, and the chapter has to say so or the row will be read as a claim
 * about a flag that does not exist.
 */
#include "mutex_case.h"

#include "../../adapter/measure.h"

#include "port.h"

#include <zephyr/kernel.h>

#define PRIO_MEASURER 5
#define PRIO_MEDIUM   6
#define PRIO_HOLDER   7

#define STACK_SIZE 1024

/* Work, in loop iterations rather than in microseconds, because the point is the ratio between
 * the two and a figure in microseconds would need a calibration this case does not have.
 * Medium is given four times the holder's, which is what makes the prediction checkable. */
#define HOLD_SPIN   2000u
#define MEDIUM_SPIN 8000u

K_THREAD_STACK_DEFINE(holder_stack, STACK_SIZE);
K_THREAD_STACK_DEFINE(medium_stack, STACK_SIZE);
static struct k_thread holder_thread;
static struct k_thread medium_thread;

static K_MUTEX_DEFINE(inheriting_lock);
static K_SEM_DEFINE(plain_lock, 1, 1);

static K_SEM_DEFINE(start_hold, 0, 1);
static K_SEM_DEFINE(lock_taken, 0, 1);
static K_SEM_DEFINE(start_medium, 0, 1);
static K_SEM_DEFINE(medium_done, 0, 1);

/* Which arm is running. Read by the holder, written by the measurer between arms. */
static volatile bool inheriting;
static volatile bool threads_started;

static void spin(uint32_t iterations)
{
	volatile uint32_t sink = 0u;
	uint32_t i;

	for (i = 0u; i < iterations; i++) {
		sink = sink + 1u;
	}
}

static void lock_take(void)
{
	if (inheriting) {
		(void)k_mutex_lock(&inheriting_lock, K_FOREVER);
	} else {
		(void)k_sem_take(&plain_lock, K_FOREVER);
	}
}

static void lock_release(void)
{
	if (inheriting) {
		(void)k_mutex_unlock(&inheriting_lock);
	} else {
		k_sem_give(&plain_lock);
	}
}

static void holder_fn(void *a, void *b, void *c)
{
	ARG_UNUSED(a);
	ARG_UNUSED(b);
	ARG_UNUSED(c);

	for (;;) {
		k_sem_take(&start_hold, K_FOREVER);
		lock_take();
		/* Announce BEFORE the work, not after. The measurer has to attempt the lock
		 * while this thread is still inside the work, and announcing afterwards would
		 * leave nothing to contend for. */
		k_sem_give(&lock_taken);
		spin(HOLD_SPIN);
		lock_release();
	}
}

static void medium_fn(void *a, void *b, void *c)
{
	ARG_UNUSED(a);
	ARG_UNUSED(b);
	ARG_UNUSED(c);

	for (;;) {
		k_sem_take(&start_medium, K_FOREVER);
		spin(MEDIUM_SPIN);
		k_sem_give(&medium_done);
	}
}

void mutex_case_run(bool with_inheritance, uint32_t *counts, size_t n)
{
	size_t i;

	if (!threads_started) {
		k_thread_create(&holder_thread, holder_stack, STACK_SIZE, holder_fn,
				NULL, NULL, NULL, PRIO_HOLDER, 0, K_NO_WAIT);
		k_thread_create(&medium_thread, medium_stack, STACK_SIZE, medium_fn,
				NULL, NULL, NULL, PRIO_MEDIUM, 0, K_NO_WAIT);
		threads_started = true;
	}

	inheriting = with_inheritance;

	for (i = 0u; i < n; i++) {
		/* The holder is lower priority, so this does not run it. */
		k_sem_give(&start_hold);

		/* Blocking here is what lets the holder run and acquire. It gives lock_taken
		 * from inside its work, and this thread preempts it immediately on the give,
		 * which leaves the holder runnable, mid-work, still holding the lock. */
		k_sem_take(&lock_taken, K_FOREVER);

		/* Medium becomes runnable now, after the lock is held and before it is wanted.
		 * It is lower priority than this thread, so it does not run yet. */
		k_sem_give(&start_medium);

		/* CRITERION 3 FOR THIS ROW, and the placement is the lesson of Friday 9
		 * October 2026 rather than a guess. The bracket opens on the next statement,
		 * in this thread, so the invalidation goes immediately before it and outside
		 * it. Everything the bracket then contains starts cold: this thread's path into
		 * the lock, the holder's remaining work, the switches, and in the
		 * non-inheriting arm the whole of medium's work.
		 *
		 * WHAT THAT MAKES THE COLD FIGURE, said here because the figure invites a
		 * misreading. The spins inside the bracket run thousands of iterations
		 * through a handful of instructions, so they are cold for one iteration and
		 * warm for the rest. The penalty is therefore a one-time refill of the code
		 * path and not a proportional cost, which is why it will read as a few per
		 * cent here and as more than a hundred on the short rows. */
		measure_port_chill();

		counts[i] = measure_now();
		lock_take();
		counts[i] = measure_now() - counts[i];
		lock_release();

		/* Medium has to finish before the next iteration, or its work would leak into
		 * the following measurement. In the inheriting arm it has not run at all yet. */
		k_sem_take(&medium_done, K_FOREVER);
	}
}
```

## src/mutex_case.h
```c
/* projects/04-what-the-kernel-primitives-cost/zephyr/src/mutex_case.h
 *
 * Criterion 4 lives in its own translation unit because its sequencing is the measurement, and
 * three threads handing a lock between them is easier to read on one page than interleaved with
 * four unrelated operations.
 */
#ifndef MUTEX_CASE_H
#define MUTEX_CASE_H

#include <stdbool.h>
#include <stddef.h>
#include <stdint.h>

/* Fills n elapsed counts for the contended case. `with_inheritance` selects a k_mutex, which
 * always inherits, against a binary semaphore used as a lock, which does not. Those are two
 * protocols rather than two settings of one object, and the caller is expected to say so. */
void mutex_case_run(bool with_inheritance, uint32_t *counts, size_t n);

#endif /* MUTEX_CASE_H */
```

## src/port.h
```c
/* projects/04-what-the-kernel-primitives-cost/zephyr/src/port.h
 *
 * ONE DECLARATION, AND THE NAME IS THE POINT. The invalidation for criterion 3 lived as a
 * static `chill()` in main.c while only main.c needed it. On Saturday 17 October 2026 the
 * contended case joined the cold pass, and mutex_case.c needs the same call.
 *
 * It is named `measure_port_chill` because that is what the FreeRTOS tree's port.h calls it,
 * so the line inside each kernel's contended case is character for character the same. Two
 * implementations of one measurement are two chances to measure two different things, and
 * nothing inside either notices; a line that is textually identical in both can at least be
 * compared by eye and by grep. The FreeRTOS tree splits its port into a host file and a board
 * file and needs a header to join them; this tree has one port, in main.c, and needs the
 * header only for this.
 */
#ifndef P04_ZEPHYR_PORT_H
#define P04_ZEPHYR_PORT_H

/* Invalidates the instruction cache when the cold pass has asked for it, and does nothing
 * otherwise. Called at the statement before a bracket opens, which is in the measurer for most
 * rows and in the giver for the two that block, because where a bracket opens differs by
 * operation. */
void measure_port_chill(void);

#endif /* P04_ZEPHYR_PORT_H */
```
