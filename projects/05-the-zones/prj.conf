## CMakeLists.txt
```
# projects/05-the-zones/CMakeLists.txt
#
# One application, and the overlay is chosen on the command line rather than named here, which
# is P03's arrangement and its reason: a file that names the overlay becomes the thing that
# differs between two builds, and both projects want the description to be the only difference.
#
# THE CHEAP ATTEMPT FIRST. Before a driver is written for this part, the part is pointed at the
# driver the tree already carries for the generation before it, and what happens on the wire is
# reported either way. That is the step a reader asks about first and it costs one build:
#
#   cmake -B build-p05-existing -GNinja -DBOARD=nucleo_h7a3zi_q \
#         -DDTC_OVERLAY_FILE=overlays/existing_driver.overlay -S projects/05-the-zones
#   ninja -C build-p05-existing
#
# THE ENVIRONMENT COMES FIRST, and it is written here because its absence does not look like
# itself. West lives in the workspace's virtual environment on the machine this is built on:
#
#   source ~/zephyrproject/.venv/bin/activate
#
# Without it, a FRESH configure finds no modules, the vendor's devicetree directory is off the
# include path, and the board's own description fails to preprocess on a pinctrl include that is
# on disk the whole time. Established on Saturday 17 October 2026 by four configures, of which
# only the fourth was a test: the one that appeared to clear the environment had reused the build
# directory from the failure and so read a cached configure. **Remove the build directory in the
# same command as the test**, or the test is of the cache.
#
# THE SECOND DESCRIPTION, which points the part at this project's own driver and binding, is
# built the same way with a different overlay and its own build directory:
#
#   cmake -B build-p05-own -GNinja -DBOARD=nucleo_h7a3zi_q \
#         -DDTC_OVERLAY_FILE=overlays/own_driver.overlay -S projects/05-the-zones
#   ninja -C build-p05-own
#
# THE FIRMWARE IMAGE IS NOT IN THE TREE and the part cannot range without it. The vendor's
# library ships with the buffer header removed, because the operating system's rules do not
# admit a binary blob in its source, so the image is fetched once into the workspace:
#
#   west blobs fetch hal_st
#
# A run that skips it fails at initialisation, which is easy to read as a wiring fault or a
# wrong address. docs/DESIGN.md says so in more words.
cmake_minimum_required(VERSION 3.20.0)

# A LINE THAT WAS HERE AND IS NOT, AND THE REMOVAL IS THE RECORD. It read
#
#   list(APPEND DTS_ROOT ${CMAKE_CURRENT_SOURCE_DIR})
#
# and it was added on Saturday 17 October 2026 to state where this project's own bindings live
# rather than leave it to detection, which is P04's lesson about a stated overlay carried one
# level across. It is removed because the operating system already treats an application's own
# directory as a place to look for bindings, so the line said nothing the build did not know, and
# because it was the only change in this file that had never been through a successful configure
# when one began to fail. Whether it was the cause is settled by the build rather than here.
#
# The lesson it was carrying is still right and now has nowhere better to live than this comment:
# the bindings this project writes are under dts/bindings/, and a reader looking for them should
# not have to know the default to find them.

find_package(Zephyr REQUIRED HINTS $ENV{ZEPHYR_BASE})
project(the_zones C)

target_sources(app PRIVATE src/main.c src/shield_power.c src/identify.c src/vl53l8cx.c
                           src/reduce_nearest_valid.c)

# THE REDUCTION IS PLAIN C AND NAMES NO OPERATING SYSTEM, which is why it has a host suite in
# host/ that needs no board and no Zephyr. `make check` builds and runs it, and `make mutants`
# breaks it four ways and fails unless the suite notices each. It is compiled into the firmware
# here as well, so the thing the suite proves is the thing the board runs.

# ==================================================== the vendor's interface for this generation
#
# NOTHING IS VENDORED, which is this volume's rule and the operating system's as well. The
# vendor's library is cloned at a pinned commit and compiled from where it lies; no copy of it,
# and no copy of the firmware image it carries, enters this repository. P04 brings in a kernel
# and a board support package the same way and for the same reasons: tens of thousands of lines
# nobody here wrote stay out of a published tree, and the version becomes part of the build
# rather than part of the history.
#
#   git clone https://github.com/STMicroelectronics/x-cube-tof1.git ~/src/x-cube-tof1
#   git -C ~/src/x-cube-tof1 checkout c12709c3ac802d91dd2a215178f53cb94c024709
#
# THE PIN IS WHAT WAS BUILT AGAINST and not what was intended, which is P04's lesson about a
# pin arriving the hard way. The clone on the demo laptop landed on c12709c, dated Thursday 3
# April 2025, and every figure this project takes comes from that revision until the line is
# changed deliberately and the change is dated.
#
# AND UNTIL SUNDAY 18 OCTOBER 2026 THAT PARAGRAPH WAS NOT TRUE, which is worth keeping rather
# than quietly fixing. The revision appeared in this file only inside the comment above: no cmake
# command read it, so the build compiled whatever revision happened to be checked out in the
# clone, and a `git pull` in that directory would have moved every figure this project publishes
# without changing a line here. The claim that "the version becomes part of the build rather than
# part of the history" was a claim about a comment. **A rule named in prose and enforced by
# nothing is this volume's most repeated defect**, and the fix is the eight lines below.
#
# Override VL53L8CX_ULD to point somewhere else.
set(VL53L8CX_ULD "$ENV{HOME}/src/x-cube-tof1/Drivers/BSP/Components/vl53l8cx/modules"
    CACHE PATH "the vendor's ultra lite driver for this generation, cloned not copied")

set(VL53L8CX_ULD_COMMIT "c12709c3ac802d91dd2a215178f53cb94c024709"
    CACHE STRING "the vendor revision every figure in this project was measured against")

# THE ABSENCE IS REPORTED WITH THE COMMAND THAT FIXES IT, because a missing clone otherwise
# arrives as a compiler saying it cannot find a header, which names the symptom and not the step.
if(NOT EXISTS "${VL53L8CX_ULD}/vl53l8cx_api.c")
  message(FATAL_ERROR
    "No vendor interface at ${VL53L8CX_ULD}.
"
    "  git clone https://github.com/STMicroelectronics/x-cube-tof1.git ~/src/x-cube-tof1
"
    "Nothing is vendored into this repository, so it has to be cloned once.")
endif()

# THE CLONE IS ASKED WHAT REVISION IT IS AT, because the alternative is to trust it. `git -C` on
# the modules subdirectory walks up to the clone's own root, so no second path is needed.
execute_process(
  COMMAND git -C "${VL53L8CX_ULD}" rev-parse HEAD
  OUTPUT_VARIABLE uld_head
  OUTPUT_STRIP_TRAILING_WHITESPACE
  RESULT_VARIABLE uld_rc
  ERROR_QUIET)

if(NOT uld_rc EQUAL 0)
  message(FATAL_ERROR
    "Cannot ask git what revision ${VL53L8CX_ULD} is at.
"
    "That directory exists but is not inside a git clone, which usually means the vendor's source
"
    "was copied rather than cloned. This project states the revision every figure came from, so
"
    "it has to be able to read it:
"
    "  git clone https://github.com/STMicroelectronics/x-cube-tof1.git ~/src/x-cube-tof1
"
    "  git -C ~/src/x-cube-tof1 checkout ${VL53L8CX_ULD_COMMIT}")
elseif(NOT uld_head STREQUAL "${VL53L8CX_ULD_COMMIT}")
  # DELIBERATELY FATAL. Building against another revision is a legitimate thing to want and it is
  # not something to do by accident: every figure in docs/RESULTS and every number in the chapter
  # is attributed to the pinned one. The escape hatch is explicit and says so in the log.
  if(VL53L8CX_ULD_ANY_REVISION)
    message(WARNING
      "The vendor clone is at ${uld_head}, not the pinned ${VL53L8CX_ULD_COMMIT}, and "
      "VL53L8CX_ULD_ANY_REVISION is set, so this build is going ahead. Nothing measured from it "
      "may be quoted beside a figure taken against the pin without saying so.")
  else()
    message(FATAL_ERROR
      "The vendor clone is at a different revision than this project is written against.
"
      "  clone is at   ${uld_head}
"
      "  pinned here   ${VL53L8CX_ULD_COMMIT}
"
      "Every figure this project publishes was measured against the pinned one, so the build
"
      "refuses rather than quietly producing numbers that belong to another revision:
"
      "  git -C ${VL53L8CX_ULD} checkout ${VL53L8CX_ULD_COMMIT}
"
      "To build against the clone's revision on purpose, configure with
"
      "-DVL53L8CX_ULD_ANY_REVISION=ON, which warns instead and marks the build as unpinned.")
  endif()
else()
  message(STATUS "vendor interface at the pinned ${VL53L8CX_ULD_COMMIT}")
endif()

# The porting layer is ours and comes first on the include path, so the library finds this
# project's platform.h rather than the vendor's reference one. src/platform.h says why.
target_include_directories(app PRIVATE src "${VL53L8CX_ULD}")

target_sources(app PRIVATE
  src/vl53l8cx_platform.c
  "${VL53L8CX_ULD}/vl53l8cx_api.c")

# THE LIBRARY IS NOT HELD TO THIS PROJECT'S WARNINGS. It is somebody else's code, used
# unmodified, and a warning in it is not a defect this repository can fix without forking it.
set_source_files_properties("${VL53L8CX_ULD}/vl53l8cx_api.c" PROPERTIES COMPILE_OPTIONS "-w")

# ================================================= what the image is, regenerated at every build
#
# THIS IS A CORRECTION AND NOT A FEATURE. The banner used to print `__DATE__` and `__TIME__` from
# main.c. Those two macros are fixed when that one file is compiled, and a build that changes any
# other file does not recompile it: on Saturday 17 October 2026 at 16:51 an image built from an
# edit to the driver printed a stamp 69 minutes old. The reading that followed was nearly thrown
# away as a stale flash, which is the dangerous direction for a guard to fail in.
#
# THE COMMAND RUNS EVERY BUILD, BY CONSTRUCTION, and the construction is written further down
# rather than here, because the first attempt at it was wrong in a way worth keeping. The
# generated file changes on every build, its translation unit recompiles, and the image is
# relinked. That cost is one small compile and one link, paid so the console cannot claim an
# age the image does not have.
# `ninja` in this project is consequently never a no-op, which is the intended arrangement.
#
# THE OUTPUT FORM IS USED RATHER THAN A BYPRODUCT, so the build system has a real rule producing
# a real file and the first build cannot race its own generator.
set(BUILD_STAMP_C "${CMAKE_CURRENT_BINARY_DIR}/build_stamp.c")
set(REPO_ROOT "${CMAKE_CURRENT_SOURCE_DIR}/../..")

# THE INTERPRETER IS THE ONE THE OPERATING SYSTEM'S BUILD ALREADY FOUND, because the build runs
# inside a virtual environment where the bare name resolves differently than outside it. The
# fallback exists so that a missing variable arrives as a sentence about Python rather than as a
# command that cannot be run.
if(NOT DEFINED PYTHON_EXECUTABLE)
  find_package(Python3 REQUIRED COMPONENTS Interpreter)
  set(PYTHON_EXECUTABLE "${Python3_EXECUTABLE}")
endif()

# AND THE ARRANGEMENT ABOVE DID NOT WORK, WHICH IS WHY IT IS DESCRIBED IN THE PAST TENSE. It
# read
#
#   add_custom_target(stamp_always)
#   add_custom_command(OUTPUT ... DEPENDS stamp_always ...)
#
# on the reasoning quoted above, that "a custom target with no output is always out of date, so
# a command that depends on one is never skipped". **That reasoning is about make, and this
# volume builds with ninja.** CMake turns a target named in DEPENDS into a dependency on that
# target's phony edge, and ninja treats a phony edge with no inputs as already up to date. So the
# stamp was written once, when the build directory was new, and never again.
#
# FOUND ON MONDAY 26 OCTOBER 2026 AT THE BENCH, and it cost most of a session. Four captures
# were taken for the orientation runs of docs/ORIENTATION.md and all four printed `built Tuesday
# 20 October 2026, 11:57:44` and `from f2cdf51` from a tree at 50ffade. They were read as a stale
# flash and nearly discarded. The flash was good every time, the build was good every time, and
# `build-p05-own/build_stamp.c` had the modification time of the first build in that directory.
# **A guard that cries stale about a correct image discards real results**, which is the failure
# scripts/stamp.py's own docstring names as the worse of the two directions.
#
# WHAT WORKS WAS MEASURED RATHER THAN REASONED, because the reasoning is what failed the first
# time. scripts/test_build_stamp.py configures four wirings under ninja, builds each twice and
# reads the generated file, and it is the authority for this paragraph rather than this paragraph
# being the authority for it. On Monday 26 October 2026, with ninja 1.13.2 and cmake 4.4.2:
#
#   a target with no output, named in DEPENDS          stamps once only, which was the defect
#   an output that is never created                    stamps once only, which is the surprise
#   the same output, declared SYMBOLIC                 regenerates at every build
#   add_custom_target(... ALL COMMAND ...)             regenerates at every build
#
# THE SECOND LINE IS THE ONE TO REMEMBER. A rule whose output does not exist after it runs is
# widely held to be unconditional, and under this generator it is not: ninja is told the file is
# expected and does not reconsider the rule that makes it. The property below is what tells cmake
# the name is not a file at all, and only then does the edge stay dirty.
#
# THE FOURTH LINE WOULD ALSO HAVE WORKED and is not used, because a custom target reaches the
# compile through a target-level ordering rather than through the generated file itself, and the
# paragraph above about the output form rather than a byproduct is still the right preference:
# the one real file is what the compile depends on, so the first build cannot race its generator.
set(STAMP_NEVER_MADE "${CMAKE_CURRENT_BINARY_DIR}/stamp.never-made")

add_custom_command(
  OUTPUT "${STAMP_NEVER_MADE}"
  COMMAND "${CMAKE_COMMAND}" -E true
  COMMENT "the dependency that is never satisfied, so that the stamp is never skipped"
  VERBATIM)

# AND THIS LINE IS THE WHOLE FIX. Without it the rule above is skipped from the second build on.
set_source_files_properties("${STAMP_NEVER_MADE}" PROPERTIES SYMBOLIC TRUE)

add_custom_command(
  OUTPUT "${BUILD_STAMP_C}"
  COMMAND "${PYTHON_EXECUTABLE}" "${REPO_ROOT}/scripts/stamp.py"
          --out "${BUILD_STAMP_C}"
          --scope "projects/05-the-zones"
  DEPENDS "${STAMP_NEVER_MADE}" "${REPO_ROOT}/scripts/stamp.py"
  COMMENT "stamping the image with the time and the commit"
  VERBATIM)

target_sources(app PRIVATE "${BUILD_STAMP_C}")
```

## prj.conf
```kconfig
# projects/05-the-zones/prj.conf
#
# DELIBERATELY SHORT, and the shortness is the point rather than an omission. The driver for
# this family is enabled by the devicetree and not from here: its Kconfig reads
# `default y` with `depends on DT_HAS_ST_VL53L5CX_ENABLED`, so describing the part in the
# overlay is what turns the driver on. A line here naming the driver would be a second place
# the same decision is made, and P03 established that the bus is a description rather than a
# configuration line.
#
# The vendor library is selected by the driver too, through `select HAS_STLIB`, so this file
# does not name that either. What it cannot supply is the binary firmware image, which is not
# in the tree at all and is fetched with `west blobs fetch hal_st`; see ../docs/DESIGN.md.

CONFIG_SENSOR=y

# THE PIN CONTROLLERS, AND THE REASON THIS LINE IS NEEDED IS THE CHAPTER'S ARGUMENT. The first
# build with src/shield_power.c in it failed to link:
#
#     undefined reference to `__device_dts_ord_42'
#     undefined reference to `__device_dts_ord_43'
#
# Those two ordinals are the pin controllers the shield's supply-enable and low-power pins sit
# on, and they were absent because nothing in the build had asked for them. **The in-tree driver
# for this family drives no pin, so it selects no pin driver**, and a build containing that
# driver and nothing else has no general-purpose output at all. The project asserted that from
# reading the driver's source and its eleven-line binding; the linker has now said the same
# thing in its own words, which is a better kind of evidence.
CONFIG_GPIO=y

# THE BUS CONTROLLER, FOR THE SAME REASON ONE LEVEL ALONG, and the reason is a real difference
# between a driver in the tree and a driver in an application. The first build of this project's
# own driver did not link:
#
#     app/libapp.a(vl53l8cx.c.obj): undefined reference to `__device_dts_ord_31'
#
# which is the two-wire controller the part sits on. The build that uses the tree's driver for
# the previous generation never needed this line, because that driver has a Kconfig of its own
# and it reads `select I2C`. **A source file in an application has no Kconfig and can select
# nothing**, so everything it depends on has to be named here.
#
# That is one of the concrete arguments for this driver eventually being a module with its own
# Kconfig rather than a file in an application: a driver should carry its own dependencies, and
# a reader who copies the driver without copying this file should not get a link error for it.
CONFIG_I2C=y

# THE DRIVER'S OWN LOG IS THE DIAGNOSIS, which is why logging is on in a project that measures
# nothing. This part uploads a firmware image at initialisation and the interesting failures all
# happen there: a missing image, a wrong address, a part that does not answer. Without the log
# those arrive as one line saying the device is not ready, which names none of them.
#
# P04 turned logging off because a synchronous console write inside a measured interval is
# expensive and lands in the figure. Nothing here is measured, so the trade goes the other way.
CONFIG_LOG=y
CONFIG_SENSOR_LOG_LEVEL_DBG=y

# Sixty-four zones with several fields each is a large result, so the stack that holds one is
# not the default. The figure is revised once the result structure's size is known from a build
# rather than estimated here.
CONFIG_MAIN_STACK_SIZE=4096

CONFIG_ASSERT=y
```

## dts/bindings/sensor/st,vl53l8cx.yaml
```yaml
# Copyright (c) 2026 Joseph Ambrose Pagaran
# SPDX-License-Identifier: Apache-2.0
#
# THE BINDING FOR THIS GENERATION, AND THE THREE PROPERTIES ARE THE POINT OF IT.
#
# The operating system carries a binding for the generation before this one. It is eleven lines:
# a compatible string and two includes, with no property of its own. That binding describes a
# part that is always powered, never held in a low-power state and never asks to be read. On the
# expansion board this project uses, none of those three is true, and the run of Saturday 17
# October 2026 at 12:17 is the evidence: with nothing driving the supply enable the part did not
# answer its address at all, and with fifteen lines driving two pins it answered immediately.
#
# A fact about how a part is wired belongs in the description of the hardware. Putting it in an
# application that happens to run first works, which is how this project proved it, and it leaves
# the next person to discover the same thing the same way.
#
# WHY ALL THREE ARE OPTIONAL rather than required. A binding describes what a board may have, not
# what one board does have. A design that ties the part's supply to a permanent rail has no
# supply-enable line to name, and a design that polls has no data-ready line. Each property says
# what the driver does when it is absent, which is the part a reader needs.

description: |
  STMicroelectronics VL53L8 series time-of-flight sensor, eight by eight multizone.

  Reports a grid of sixty-four distances with a status for each, so that an empty scene and a
  surface beyond range are different facts rather than the same number.

  This part uploads a firmware image at initialisation and identifies itself as device 0xF0 at a
  revision distinct from the VL53L5CX, which is why it is a separate compatible rather than an
  addition to that one. A driver should read that identity and refuse a part it does not know
  before it sends an image, which costs four bus transactions against several seconds.

compatible: "st,vl53l8cx"

include: [sensor-device.yaml, i2c-device.yaml]

properties:
  pwren-gpios:
    type: phandle-array
    description: |
      The expansion board's supply enable, active high, driven before anything speaks to the
      part and held for the life of the device.

      Absent means the part is permanently powered and the driver drives nothing. Present means
      the driver asserts it and waits for the part to settle before its first transaction; on
      the board this binding was written against the vendor's own example waits ten
      milliseconds, and a shorter wait was not tried.

      With this line low the part does not acknowledge its address, so a bus scan finds nothing
      and every other diagnosis is misleading.

  lpn-gpios:
    type: phandle-array
    description: |
      The part's low-power enable, active high, asserted to bring it out of its low-power state.

      Absent means the part is never placed in that state by this system. It is separate from
      the supply enable because the two are separate pins on the part and a design may tie one
      and drive the other.

  int-gpios:
    type: phandle-array
    description: |
      The data-ready line the part asserts when a ranging result is available.

      Absent means the driver polls, which is what the operating system's driver for the
      previous generation does and the only thing its binding allows. Present means a thread
      can wait rather than poll, which is the difference this project's fourth acceptance
      criterion is about: with the line connected a reading thread runs at the ranging
      frequency rather than at whatever rate a loop happens to have.
```

## src/main.c
```c
/* projects/05-the-zones/src/main.c: the identification run, and the bus scan that diagnoses it.
 *
 * WHAT THIS FILE IS FOR, AND WHAT IT DELIBERATELY DOES NOT DO. It scans the bus, asks whether
 * the device behind one devicetree alias came up, reports both, and stops. It does not read the
 * grid. That is not an oversight: it is the first acceptance criterion of this project standing
 * on its own, and it is the one run that can be made before the grid's read interface has been
 * read rather than guessed.
 *
 * THE SCAN WAS ADDED AFTER THE FIRST RUN, on Saturday 17 October 2026 at 11:16, and the reason
 * is worth the paragraph. That run printed `NOT READY` and the driver logged `Failed to
 * initialize the sensor (255)`, which is the vendor library's generic error. The project had
 * written three candidate causes down in advance, and the generic error distinguishes none of
 * them: a part at a different address, a part held in its low-power state and a part whose
 * interface jumper selects the other bus all fail identically from inside a driver that only
 * ever talks to one address.
 *
 * A SCAN SEPARATES THEM IN ONE RUN, which is why it is here rather than a second guess at the
 * address:
 *
 *   nothing answers anywhere          the part is not on this bus at all. Either it is not
 *                                     powered, or it is held in its low-power state, or the
 *                                     jumper selects the four-wire bus. No address is wrong,
 *                                     because no address is right
 *   something answers at the address  the overlay is right and the failure is inside
 *     the overlay names                initialisation, which points at the firmware image or at
 *                                     a genuine difference between the two generations
 *   something answers elsewhere       the overlay's address is wrong and the scan has just
 *                                     printed the right one
 *   everything answers               the scan itself is void on this controller, which it says
 *                                     rather than reporting 112 sensors
 *
 * THE LAST ROW IS THE POINT OF A SCAN THAT CAN FAIL. A probe is a zero-length write and a
 * controller that does not implement one can report success for every address. A scan that
 * cannot tell that about itself would hand back a list of 112 devices and look authoritative.
 */
#include <zephyr/device.h>
#include <zephyr/drivers/i2c.h>
#include <zephyr/drivers/sensor.h>
#include <zephyr/kernel.h>

#include <stdbool.h>
#include <stdio.h>

#include "build_stamp.h"

#if DT_NODE_HAS_COMPAT(DT_ALIAS(zones), st_vl53l8cx)
#define READS_THE_GRID 1
#include "zones.h"
#include "zone_status.h"
#include "reduce_nearest_valid.h"
#else
/* The description that points this part at the tree's driver for the generation before it gets
 * no grid, because that driver does not bring this part up at all. One application serves two
 * descriptions and this is the one place they differ. */
#define READS_THE_GRID 0
#endif

/* The application's only piece of hardware knowledge, and it names no bus, no address and no
 * pin. P03 established that shape. The bus below is derived from the part rather than named
 * again, so the scan cannot drift to a different controller than the device sits on. */
static const struct device *const zones = DEVICE_DT_GET(DT_ALIAS(zones));
static const struct device *const bus = DEVICE_DT_GET(DT_BUS(DT_ALIAS(zones)));

#define ZONES_ADDR DT_REG_ADDR(DT_ALIAS(zones))

/* The seven-bit range a device may occupy, with the reserved blocks at each end left out, which
 * is the range the operating system's own shell scans. */
#define FIRST_ADDR 0x08
#define LAST_ADDR  0x77

static int scan_bus(void)
{
	int found = 0;
	uint16_t addr;
	uint8_t byte = 0;

	printf("\n# bus scan on %s, addresses 0x%02x to 0x%02x\n",
	       bus->name, FIRST_ADDR, LAST_ADDR);

	for (addr = FIRST_ADDR; addr <= LAST_ADDR; addr++) {
		struct i2c_msg probe = {
			.buf = &byte,
			.len = 0u,
			.flags = I2C_MSG_WRITE | I2C_MSG_STOP,
		};

		if (i2c_transfer(bus, &probe, 1, addr) == 0) {
			printf("#   0x%02x answers%s\n", addr,
			       addr == ZONES_ADDR ? ", which is the address the overlay names" : "");
			found++;
		}
	}

	if (found == 0) {
		printf("#   nothing answered. The part is not on this bus: not powered, held in\n");
		printf("#   its low-power state, or the jumper selects the four-wire bus\n");
	} else if (found > (LAST_ADDR - FIRST_ADDR) / 2) {
		/* THE SCAN SAYING IT IS VOID, which is the whole reason it counts. */
		printf("#   %d of %d addresses answered, so THIS SCAN IS VOID: a controller that\n",
		       found, LAST_ADDR - FIRST_ADDR + 1);
		printf("#   does not implement a zero-length write reports success for every\n");
		printf("#   address. Nothing above is evidence of a device\n");
		return -1;
	}

	printf("#   %d device(s) answered\n", found);
	return found;
}

#if READS_THE_GRID
/* SIXTY-FOUR DISTANCES AND SIXTY-FOUR STATUSES, PRINTED TOGETHER, which is this project's second
 * acceptance criterion in a format rather than in a sentence: an empty scene and a surface beyond
 * range both have a number in the distance, and only the status tells them apart.
 *
 * NOTHING HERE TURNS A STATUS INTO A WORD, because a mapping read off the shape of the data
 * would be a guess wearing a label. It comes from the vendor's own source or it does not appear.
 *
 * ONE FACT NOW COMES FROM THAT SOURCE, quoted from the header this project compiles against, at
 * the commit CMakeLists.txt pins, beside the `target_status` field:
 *
 *     Status indicating the measurement validity (5 & 9 means ranging OK)
 *
 * So two values mean a measurement and every other value means something that is not one. **What
 * the other values mean is still not established and is still not invented.** The only
 * documentation in that pinned tree is `Documentation/X_CUBE_TOF1.chm`, a compiled help file, and
 * no source file in it enumerates the values. The number is therefore still printed as a number,
 * with the one distinction the vendor does state marked beside it and counted underneath.
 *
 * THAT QUOTATION SEEMED TO COLLIDE WITH THE ONLY DATA THIS PROJECT HAD, and on Sunday 18 October
 * 2026 this comment refused to choose between two readings of it. Seven boots on Tuesday 20
 * October 2026 chose: status 6 is the first frame after ranging starts, every zone, every boot,
 * and status 5 is every frame after it. Both Saturday grids were first frames. A first frame can
 * be a coherent surface or sixty-four zones of noise and the status does not say which, so the
 * vendor's exclusion of it is right and the zero this printer shows on frame 1 is the expected
 * result. src/zone_status.h carries the full record, including 255 for a zone that saw no target
 * and 4 for the whole field with an object at the sensor face.
 *
 * THE ORIENTATION IS UNESTABLISHED AND IS SAID TO BE. The grid is printed in the order the part
 * returns it, and which physical corner the first zone is has not been shown. That is the fifth
 * acceptance criterion and it needs a hand over one quadrant, not a reading of this file. */
/* HOW LONG TO WAIT FOR ONE RESULT BEFORE SAYING SO. Generous, because the ranging rate is the
 * vendor's default and this project has not read what that is; a bound that is too tight would
 * turn a slow part into a broken one on the console. */
#define FRAME_WAIT_MS 2000

/* WHAT P01 WOULD RECEIVE, WHICH IS THE SIXTH CRITERION MADE VISIBLE. That criterion asks that
 * P01's application be unchanged and only its range source differ, and docs/DESIGN.md narrows it:
 * what cannot be unchanged is that something now chooses one number from sixty-four. The driver
 * does not choose. src/reduce_nearest_valid.c does, its policy is in its filename, and this is
 * the one place a run shows what that policy produces.
 *
 * THE INTERESTING CASE IS THE REFUSAL. P01's test is `range_mm <= range_mm_max`, so a reduction
 * that returned zero when it had no reading would hand P01 the closest possible object and
 * manufacture a presence. The result therefore carries `found` separately, and the correct
 * response to false is to post no reading event at all. On the only grid this project has
 * recorded, every zone was status 6 and this prints exactly that refusal. */
static void print_reduction(const struct zones_grid *grid)
{
	struct reduce_nearest_valid_result r =
		reduce_nearest_valid(grid->distance_mm, grid->status, ZONES_TOTAL);

	printf("# the nearest valid zone, which is what P01 would be given:\n");
	if (r.found) {
		printf("#   %d mm from zone %u, with %u of %d zones valid\n",
		       r.distance_mm, r.zone, r.valid_zones, ZONES_TOTAL);
	} else {
		printf("#   NO READING, because %u of %d zones carry a status the vendor calls\n",
		       r.valid_zones, ZONES_TOTAL);
		printf("#   ranging OK. P01 would be posted no reading event at all, which is not\n");
		printf("#   the same as being told the range is zero\n");
	}
}

static void print_grid(int frame)
{
	struct zones_grid grid;
	int64_t began = k_uptime_get();
	int64_t ready_at;
	int rc;
	int row;
	int col;
	int ok;

	/* POLLING, NOT A FIXED DELAY, and the time it took is printed. The run of 15:35 showed
	 * why one frame is not enough: the first grid after a cold start was seven millimetres
	 * of noise with ten zones reading negative, and the next was a coherent surface at two
	 * and a half metres. Taking several frames in one run shows the settling instead of
	 * leaving it to be inferred from two boots. The interval between frames is also the
	 * ranging period, measured rather than assumed. */
	do {
		rc = sensor_sample_fetch(zones);
		if (rc == -EAGAIN) {
			k_msleep(5);
		}
	} while (rc == -EAGAIN && (k_uptime_get() - began) < FRAME_WAIT_MS);

	ready_at = k_uptime_get();

	if (rc == -EAGAIN) {
		printf("\n# frame %d: no result in %d ms, so none is printed\n", frame,
		       FRAME_WAIT_MS);
		return;
	}
	if (rc != 0) {
		printf("\n# frame %d: the fetch failed: %d. No grid is printed, because a value\n",
		       frame, rc);
		printf("# that might not be a measurement is not printed as one\n");
		return;
	}

	rc = zones_read(zones, &grid);
	if (rc != 0) {
		printf("\n# frame %d: the grid could not be read: %d\n", frame, rc);
		return;
	}

	printf("\n# frame %d, ready after %d ms of waiting, at %d ms since boot\n", frame,
	       (int)(ready_at - began), (int)ready_at);
	printf("# distance in millimetres, then the vendor's status, then an asterisk when that\n");
	printf("# status is 5 or 9, the only two the vendor's own header calls ranging OK. The\n");
	printf("# other values are printed as numbers because the pinned tree documents them\n");
	printf("# only in a compiled help file, and the orientation is still unestablished\n");
	printf("# silicon temperature %d C\n", grid.silicon_temp_degc);

	ok = 0;
	for (row = 0; row < ZONES_ACROSS; row++) {
		printf("#  ");
		for (col = 0; col < ZONES_ACROSS; col++) {
			int i = row * ZONES_ACROSS + col;
			bool valid = zone_status_is_ranging_ok(grid.status[i]);

			if (valid) {
				ok++;
			}
			/* The asterisk is the vendor's distinction and not this project's opinion
			 * of the number: a zone without one has a distance that is not a
			 * measurement, whatever it reads. */
			printf(" %5d/%-2u%c", grid.distance_mm[i], grid.status[i],
			       valid ? '*' : ' ');
		}
		printf("\n");
	}
	printf("# %d of %d zones are marked, which is this frame's count of statuses 5 and 9, the\n",
	       ok, ZONES_TOTAL);
	printf("# only two the vendor's header calls ranging OK. Zero on frame 1 is expected: the\n");
	printf("# first frame after ranging starts is status 6 on every boot seen, and the vendor is\n");
	printf("# right to exclude it, since a first frame can be a surface or noise and the status\n");
	printf("# does not say which. 255 is a zone that saw no target; 4 is the whole field with\n");
	printf("# something at the sensor face. src/zone_status.h carries the record.\n");

	printf("# targets each zone saw, where zero means the zone saw nothing at all\n");
	for (row = 0; row < ZONES_ACROSS; row++) {
		printf("#  ");
		for (col = 0; col < ZONES_ACROSS; col++) {
			printf(" %u", grid.targets[row * ZONES_ACROSS + col]);
		}
		printf("\n");
	}

	print_reduction(&grid);
}
#endif

int main(void)
{
	/* THE DRIVER'S LOG ARRIVES BEFORE THIS FUNCTION AND IS FLUSHED AFTER IT, which the first
	 * run showed: initialisation happens at boot and its error landed below this
	 * application's advice, so the console read as advice first and diagnosis second. The
	 * sleep lets the deferred log drain, so that the order on the console is the order in
	 * which things happened. */
	k_msleep(200);

	printf("\np05 the zones, identification run\n");
	/* THE STAMP IS THE LINK'S AND NOT THIS FILE'S, which it used not to be. `__DATE__` here
	 * reported a time 69 minutes old for an image built minutes earlier, because an edit to
	 * the driver does not recompile main.c. scripts/stamp.py is run at every build instead,
	 * and build_stamp.h records what went wrong with the first arrangement. */
	printf("# built %s\n", build_stamp_when);
	printf("# from %s, and a stamp older than your last edit means a stale flash\n",
	       build_stamp_commit);
	printf("# the overlay names address 0x%02x on %s\n", (unsigned int)ZONES_ADDR, bus->name);
	printf("# this run asks two questions: what is on the bus, and did the device come up\n");
	printf("# it does not read the grid, and ../docs/DESIGN.md says why not yet\n");

	if (!device_is_ready(bus)) {
		printf("\nNOT READY %s, the bus controller itself\n", bus->name);
		printf("# nothing below would mean anything, so the scan is not run\n");
		return 1;
	}

	(void)scan_bus();

	if (!device_is_ready(zones)) {
		/* NOT A GRID OF ZEROES, which is the failure criterion 1 exists to prevent. The
		 * scan above is now the diagnosis and this block only says how to read it. */
		printf("\nNOT READY %s\n", zones->name);
		printf("# read the scan above, not this list:\n");
		printf("#   nothing answered     the part is not on the bus. Power, the low-power\n");
		printf("#                        line, or the interface jumper\n");
		printf("#   0x%02x answered         the address is right and initialisation failed,\n",
		       (unsigned int)ZONES_ADDR);
		printf("#                        which points at the firmware image or at a real\n");
		printf("#                        difference between the two generations\n");
		printf("#   another address      the overlay is wrong and the scan printed the\n");
		printf("#                        right answer\n");
		printf("# No reading is printed, because a value that might not be a measurement\n");
		printf("# is not printed as one\n");
		return 1;
	}

	/* THE NODE'S NAME SAYS WHOSE DRIVER THIS IS, and this text used not to, which is a
	 * defect this run found in the application rather than in the firmware. It read that
	 * the driver the tree already carries binds and initialises this part, which is true
	 * of the description pointing the part at the tree's driver for the previous
	 * generation and false of the one pointing it at this project's own, which is the
	 * description that printed it. One application serving two descriptions may not carry
	 * a sentence that is only true of one of them. */
	printf("\nREADY %s\n", zones->name);
	printf("# a driver bound this node and initialised the part, and the node's name above\n");
	printf("# says which: vl53l5cx is the tree's, for the generation before this one, and\n");
	printf("# vl53l8cx is this project's own.\n");
	printf("# This is the beginning of the question rather than the end: what the two\n");
	printf("# generations differ in is read from the grid, which follows.\n");

#if READS_THE_GRID
	/* FOUR FRAMES AND NOT ONE. A processor reset does not reset this part: it keeps
	 * ranging across one, which is why the two boots of 15:35 from a single button press
	 * showed noise and then a surface. Several frames in one run make the settling visible
	 * rather than something a reader has to infer from two logs. */
	for (int frame = 1; frame <= 4; frame++) {
		print_grid(frame);
	}
#else
	printf("# This description uses the tree's driver, which does not bring this part up,\n");
	printf("# so there is no grid to read and none is invented.\n");
#endif
	return 0;
}
```

## src/build_stamp.h
```c
/* projects/05-the-zones/src/build_stamp.h: what the image is, declared where anything can print it.
 *
 * THE DEFINITIONS ARE NOT IN THE TREE. They are generated into the build directory by
 * scripts/stamp.py, which the project's CMakeLists.txt runs at every build, so the strings
 * describe the link that produced the image rather than the last compile of whichever file
 * happened to contain a `__DATE__`.
 *
 * WHY THAT DISTINCTION IS NOT PEDANTRY. The banner's old form was `__DATE__` and `__TIME__` in
 * main.c, added so that a stale flash could be told from a reproduction. On Saturday 17 October
 * 2026 at 16:51 an image built after an edit to the driver printed a stamp 69 minutes old,
 * because main.c had not been recompiled and did not need to be. The image was new and the
 * stamp said it was not, so the guard against reading stale output became a reason to discard a
 * real result. scripts/stamp.py carries the full reasoning.
 *
 * AND "AT EVERY BUILD" WAS NOT TRUE UNTIL FRIDAY 6 NOVEMBER 2026, which is recorded here
 * because this file is where a reader comes to find out what the stamp guarantees. The rule
 * depended on a custom target carrying no output, which is unconditional under make and already
 * satisfied under ninja, so the generated file was written once when a build directory was
 * created and never again. On Monday 26 October 2026 four bench captures printed a stamp eleven
 * hours old from images that were all correct, and the first reading of them was that the flash
 * was stale. **The same failure as the one above, one layer down**, and in the same direction:
 * what a false stale report throws away is a real result.
 *
 * The fix is the SYMBOLIC property in the project's CMakeLists.txt, which is measured rather
 * than reasoned, because the obvious fix was also wrong. scripts/test_build_stamp.py builds four
 * wirings twice each and keeps two of them failing on purpose, so the guarantee this header
 * describes is checked instead of asserted.
 */
#ifndef P05_BUILD_STAMP_H
#define P05_BUILD_STAMP_H

/* When this image was linked, written in full with the weekday, computed rather than taken from
 * the machine's locale so two laptops produce comparable logs. */
extern const char build_stamp_when[];

/* The commit it was built from, and how many files in this project were edited or untracked at
 * that moment. A bench build usually has some, and a stamp that hid them would be claiming the
 * image matches a published history when it does not. */
extern const char build_stamp_commit[];

#endif /* P05_BUILD_STAMP_H */
```

## src/identify.c
```c
/* projects/05-the-zones/src/identify.c: what the part says it is, before anything else asks it.
 *
 * THE QUESTION. The operating system's driver for the previous generation reaches this part,
 * uploads tens of kilobytes to it and then times out. The vendor library's own identification
 * check is four bus transactions and expects two specific bytes, so the cheapest thing a wired
 * board can tell us is whether this part answers them the way the previous generation does.
 *
 *   it answers 0xF0 and 0x02   the two generations are INDISTINGUISHABLE AT THE HANDSHAKE and
 *                              diverge only once the firmware image is booted. That is a precise
 *                              and publishable fact, and it also says the in-tree driver cannot
 *                              protect itself by checking: it will always think this part is one
 *                              of its own
 *   it answers anything else   the identification is where a driver should refuse, the in-tree
 *                              one did not, and the chapter gains a line about why
 *
 * Either answer is worth one build. Neither can be reasoned out.
 *
 * WHY THIS RUNS BEFORE THE DRIVER, at an initialisation priority between the shield's power and
 * the sensor driver's own. By the time an application's main() runs, the driver has already
 * poked this part, left it part way through an initialisation that failed, and selected a
 * register page of its own. A reading taken then would be of a part in an unknown state. Taking
 * it here means the part has been powered, has settled, and has been spoken to by nothing else.
 *
 * WHAT IT DOES TO THE PART. The vendor's own check writes a page selector, reads two bytes, and
 * writes the page selector back to the value it found useful. This file does exactly that and in
 * that order, from the library's source in the workspace rather than from any memory of a
 * register map, so that the part is left as the library's check leaves it and the driver that
 * follows meets what it would otherwise have met.
 */
#include <zephyr/devicetree.h>

/* COMPILED ONLY FOR THE DESCRIPTION THAT NEEDS IT. The overlay that points this part at the
 * tree's driver for the previous generation puts the control pins in `zephyr,user`, because that
 * driver's binding has no property for them. The overlay that points it at this project's own
 * driver puts them in the node, where the binding this project writes declares them, and the
 * driver drives them itself. So this file has nothing to do in the second case and compiles to
 * nothing, rather than being a second place the same pins are driven. */
#if DT_NODE_HAS_PROP(DT_PATH(zephyr_user), pwren_gpios)

#include <zephyr/device.h>
#include <zephyr/drivers/i2c.h>
#include <zephyr/init.h>
#include <zephyr/kernel.h>
#include <zephyr/logging/log.h>

LOG_MODULE_REGISTER(identify, CONFIG_SENSOR_LOG_LEVEL);

static const struct i2c_dt_spec part = I2C_DT_SPEC_GET(DT_ALIAS(zones));

/* From vl53l5cx_api.c, `vl53l5cx_is_alive`: a sixteen-bit register address, big endian on the
 * wire, the page selector at 0x7fff, the identity at 0 and 1, and the two values the previous
 * generation answers with. */
#define REG_PAGE     0x7fffu
#define REG_DEVICE   0x0000u
#define REG_REVISION 0x0001u
#define PAGE_IDENTITY 0x00u
#define PAGE_AFTER    0x02u
#define EXPECT_DEVICE   0xF0u
#define EXPECT_REVISION 0x02u

/* RUNS AFTER THE SHIELD IS POWERED AND BEFORE THE SENSOR DRIVER, and both halves of that are
 * asserted rather than assumed, because either one being wrong gives a reading of a part in the
 * wrong state and nothing in the output would say so. */
#define IDENTIFY_INIT_PRIORITY 60
BUILD_ASSERT(IDENTIFY_INIT_PRIORITY < CONFIG_SENSOR_INIT_PRIORITY,
	     "the part has to be read before the sensor driver has spoken to it");

static int write_reg(uint16_t reg, uint8_t value)
{
	uint8_t buf[3] = { (uint8_t)(reg >> 8), (uint8_t)(reg & 0xffu), value };

	return i2c_write_dt(&part, buf, sizeof(buf));
}

static int read_reg(uint16_t reg, uint8_t *value)
{
	uint8_t addr[2] = { (uint8_t)(reg >> 8), (uint8_t)(reg & 0xffu) };

	return i2c_write_read_dt(&part, addr, sizeof(addr), value, 1);
}

static int identify_init(void)
{
	uint8_t device = 0u;
	uint8_t revision = 0u;
	int rc;

	if (!device_is_ready(part.bus)) {
		LOG_ERR("the bus is not ready, so the part was not asked what it is");
		return -ENODEV;
	}

	rc = write_reg(REG_PAGE, PAGE_IDENTITY);
	if (rc != 0) {
		/* NOT A GUESS AT WHY. A part that does not acknowledge here is a part that is not
		 * answering at all, which the bus scan in main() reports separately and better. */
		LOG_ERR("the part did not accept the page selector: %d", rc);
		return rc;
	}

	rc = read_reg(REG_DEVICE, &device);
	if (rc == 0) {
		rc = read_reg(REG_REVISION, &revision);
	}
	if (rc != 0) {
		LOG_ERR("the identity registers did not read back: %d", rc);
		return rc;
	}

	(void)write_reg(REG_PAGE, PAGE_AFTER);

	LOG_INF("the part identifies as device 0x%02x revision 0x%02x", device, revision);
	LOG_INF("the previous generation answers device 0x%02x revision 0x%02x",
		EXPECT_DEVICE, EXPECT_REVISION);

	if (device == EXPECT_DEVICE && revision == EXPECT_REVISION) {
		LOG_INF("SAME: the two generations cannot be told apart at the handshake, so the");
		LOG_INF("  in-tree driver cannot refuse this part and will try to drive it");
	} else {
		LOG_INF("DIFFERENT: the handshake tells the two apart, so a driver could refuse");
		LOG_INF("  this part here rather than after uploading an image to it");
	}

	return 0;
}

SYS_INIT(identify_init, POST_KERNEL, IDENTIFY_INIT_PRIORITY);

#else

/* An empty translation unit is not C, so the file declares one unused type
 * rather than nothing at all. */
typedef int identify_not_used_t;

#endif
```

## src/reduce_nearest_valid.c
```c
/* projects/05-the-zones/src/reduce_nearest_valid.c: the nearest zone the vendor calls a reading.
 *
 * The interface, the policy and the three shapes this deliberately does not return are all in
 * reduce_nearest_valid.h. What is here is the loop and two decisions worth stating beside it.
 *
 * NEGATIVE DISTANCES ARE NOT FILTERED OUT, and that is deliberate rather than an omission. The
 * first grid of Saturday 17 October 2026 at 15:35 had ten of sixty-four zones reading between
 * minus two and plus five millimetres, every one of them claiming a target. A reduction that
 * silently dropped negatives would have turned that grid into a plausible answer instead of an
 * obvious one, and **the status is the field that is supposed to carry validity**. If the vendor's
 * status admits a zone, this reports what that zone said. Correcting the part's arithmetic is not
 * this file's job and hiding it is nobody's.
 *
 * THE COUNT IS CARRIED EVEN WHEN NOTHING IS FOUND, because zero valid zones out of sixty-four and
 * a grid that was never read are different situations that produce the same `found == false`. The
 * caller can tell them apart only if the count comes back.
 */
#include "reduce_nearest_valid.h"

#include "zone_status.h"

struct reduce_nearest_valid_result reduce_nearest_valid(const int16_t *distance_mm,
						       const uint8_t *status,
						       size_t count)
{
	/* EVERY FIELD NAMED, rather than `= { 0 }`. A brace-zero of a multi-member struct is what
	 * `-Wmissing-field-initializers` exists to complain about, the warning is in `-Wextra`, and
	 * this project builds with warnings as errors. Four assignments cost nothing and cannot be
	 * read two ways. */
	struct reduce_nearest_valid_result out;
	size_t i;

	out.found = false;
	out.distance_mm = 0;
	out.zone = 0u;
	out.valid_zones = 0u;

	/* A caller that passed nothing has asked nothing. Returning found == false here rather
	 * than reading through a null pointer is the same rule as everywhere else in this
	 * project: a value that might not be a measurement is not produced as one. */
	if (distance_mm == NULL || status == NULL || count == 0u) {
		return out;
	}

	for (i = 0u; i < count; i++) {
		if (!zone_status_is_ranging_ok(status[i])) {
			continue;
		}

		if (out.valid_zones < UINT8_MAX) {
			out.valid_zones++;
		}

		/* Strictly less than, so a tie keeps the zone already chosen, which is the lower
		 * index. The header states that choice rather than leaving it to this comparison
		 * being read correctly. */
		if (!out.found || distance_mm[i] < out.distance_mm) {
			out.found = true;
			out.distance_mm = distance_mm[i];
			out.zone = (uint8_t)i;
		}
	}

	return out;
}
```
